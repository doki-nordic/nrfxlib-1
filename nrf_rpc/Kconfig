## nrf_rpc/Kconfig
```kconfig
#
# Copyright (c) 2020 Nordic Semiconductor
#
# SPDX-License-Identifier: LicenseRef-BSD-5-Clause-Nordic
#

menuconfig NRF_RPC
	bool "nRF RPC (Remote Procedure Call) library"
	help
	  Enable nRF RPC (Remote Procedure Call) library

if NRF_RPC

config NRF_RPC_CBOR
	bool "Add TinyCBOR layer"
	default y
	help
	  Adds API that helps use of TinyCBOR library for data serialization.

choice
	prompt "nRF RPC transport layer"
	default NRF_RPC_TR_RPMSG

config NRF_RPC_TR_RPMSG
	bool "nRF RPC over RPMsg"
	help
	  If enabled selects RPMsg as a transport layer for nRF PRC.

config NRF_RPC_TR_CUSTOM
	bool "User provided transport layer"
	help
	  If enabled selects custom transport layer. User can provide own
	  implementation of nRF PRC transport layer. In this case
	  NRF_RPC_TR_CUSTOM_INCLUDE must be provided.

endchoice

config NRF_RPC_TR_CUSTOM_INCLUDE
	string "User provided include file for transport layer"
	depends on NRF_RPC_TR_CUSTOM
	help
	  If NRF_RPC_TR_CUSTOM is enabled this option specifies the include
	  file that contains custom transport layer API. Provided API must
	  be compatible with the template header file "rp_trans_tmpl.h".

config NRF_RPC_TRANSACTION_POLL_SIZE
	int "Number of available transactions"
	default 16
	help
	  Specifies the size of transactions pool. DKTODO: More doc

config NRF_RPC_THREAD_POOL_SIZE
	int "Number of thread in local thread pool"
	default 3
	help
	  DKTODO: More doc

endif # NRF_RPC
```

## serialization/Kconfig
```kconfig
#
# Copyright (c) 2020 Nordic Semiconductor
#
# SPDX-License-Identifier: LicenseRef-BSD-5-Clause-Nordic
#

config RP_SERIALIZATION
	bool "Enable serialization library"
	help
	  Enable serialization library, with chosen transport layer

if RP_SERIALIZATION

choice
	prompt "Serialization transport"
	default RMPSG_TRANSPORT

config RMPSG_TRANSPORT
	bool "Serialization RPMsg transport"

endchoice

endif # RP_SERIALIZATION
```
